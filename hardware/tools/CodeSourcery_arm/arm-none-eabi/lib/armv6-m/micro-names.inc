/* ISR names for micro
 *
 * Version: Sourcery G++ Lite 2011.03-42
 * Support: https://support.codesourcery.com/GNUToolchain/
 *
 * Copyright (c) 2007, 2008, 2009, 2010 CodeSourcery, Inc.
 *
 * The authors hereby grant permission to use, copy, modify, distribute,
 * and license this software and its documentation for any purpose, provided
 * that existing copyright notices are retained in all copies and that this
 * notice is included verbatim in any distributions.  No written agreement,
 * license, or royalty fee is required for any of the authorized uses.
 * Modifications to this software may be copyrighted by their authors
 * and need not follow the licensing terms described here, provided that
 * the new terms are clearly indicated on the first page of each file where
 * they apply.
 */
EXTERN (__cs3_stack)
EXTERN (__cs3_reset)
EXTERN (__cs3_isr_nmi)
EXTERN (__cs3_isr_hard_fault)
EXTERN (__cs3_isr_mpu_fault)
EXTERN (__cs3_isr_bus_fault)
EXTERN (__cs3_isr_usage_fault)
EXTERN (__cs3_isr_reserved_7)
EXTERN (__cs3_isr_reserved_8)
EXTERN (__cs3_isr_reserved_9)
EXTERN (__cs3_isr_reserved_10)
EXTERN (__cs3_isr_svcall)
EXTERN (__cs3_isr_debug)
EXTERN (__cs3_isr_reserved_13)
EXTERN (__cs3_isr_pendsv)
EXTERN (__cs3_isr_systick)
EXTERN (__cs3_isr_external_0)
EXTERN (__cs3_isr_external_1)
EXTERN (__cs3_isr_external_2)
EXTERN (__cs3_isr_external_3)
EXTERN (__cs3_isr_external_4)
EXTERN (__cs3_isr_external_5)
EXTERN (__cs3_isr_external_6)
EXTERN (__cs3_isr_external_7)
EXTERN (__cs3_isr_external_8)
EXTERN (__cs3_isr_external_9)
EXTERN (__cs3_isr_external_10)
EXTERN (__cs3_isr_external_11)
EXTERN (__cs3_isr_external_12)
EXTERN (__cs3_isr_external_13)
EXTERN (__cs3_isr_external_14)
EXTERN (__cs3_isr_external_15)
EXTERN (__cs3_isr_external_16)
EXTERN (__cs3_isr_external_17)
EXTERN (__cs3_isr_external_18)
EXTERN (__cs3_isr_external_19)
EXTERN (__cs3_isr_external_20)
EXTERN (__cs3_isr_external_21)
EXTERN (__cs3_isr_external_22)
EXTERN (__cs3_isr_external_23)
EXTERN (__cs3_isr_external_24)
EXTERN (__cs3_isr_external_25)
EXTERN (__cs3_isr_external_26)
EXTERN (__cs3_isr_external_27)
EXTERN (__cs3_isr_external_28)
EXTERN (__cs3_isr_external_29)
EXTERN (__cs3_isr_external_30)
EXTERN (__cs3_isr_external_31)
