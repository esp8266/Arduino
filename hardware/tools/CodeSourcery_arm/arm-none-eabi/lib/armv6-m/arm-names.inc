/* ISR names for arm
 *
 * Version: Sourcery G++ Lite 2011.03-42
 * Support: https://support.codesourcery.com/GNUToolchain/
 *
 * Copyright (c) 2007, 2008, 2009, 2010 CodeSourcery, Inc.
 *
 * The authors hereby grant permission to use, copy, modify, distribute,
 * and license this software and its documentation for any purpose, provided
 * that existing copyright notices are retained in all copies and that this
 * notice is included verbatim in any distributions.  No written agreement,
 * license, or royalty fee is required for any of the authorized uses.
 * Modifications to this software may be copyrighted by their authors
 * and need not follow the licensing terms described here, provided that
 * the new terms are clearly indicated on the first page of each file where
 * they apply.
 */
EXTERN (__cs3_reset)
EXTERN (__cs3_isr_undef)
EXTERN (__cs3_isr_swi)
EXTERN (__cs3_isr_pabort)
EXTERN (__cs3_isr_dabort)
EXTERN (__cs3_isr_reserved)
EXTERN (__cs3_isr_irq)
EXTERN (__cs3_isr_fiq)
