## httpd/Config.in
```kconfig
#
# For a description of the syntax of this configuration file,
# see scripts/config/Kconfig-language.txt
#

menu "Axhttpd Configuration"
depends on CONFIG_AXHTTPD

config CONFIG_HTTP_STATIC_BUILD
    bool "Static Build"
    default n
    help
        Select y if you want axhttpd to be a static build (i.e. don't use the
        axtls shared library or dll).
        
config CONFIG_HTTP_PORT
    int "HTTP port"
    default 80
    help
        The port number of the normal HTTP server. 

        You must be a root user in order to use the default port.

config CONFIG_HTTP_HTTPS_PORT
    int "HTTPS port"
    default 443
    help
        The port number of the HTTPS server.

        You must be a root user in order to use the default port.

config CONFIG_HTTP_SESSION_CACHE_SIZE
    int "SSL session cache size"
    default 5
    help
        The size of the SSL session cache.
        
        This is not actually related to the number of concurrent users, but 
        for optimum performance they should be the same (with a penalty 
        in memory usage).

config CONFIG_HTTP_WEBROOT
    string "Web root location"
    default "../www" if !CONFIG_PLATFORM_WIN32
    default "..\\www" if CONFIG_PLATFORM_WIN32
    help
        The location of the web root in relation to axhttpd. This is 
        the directory where index.html lives.

config CONFIG_HTTP_TIMEOUT
    int "Timeout"
    default 5
    help
        Set the timeout of a connection in seconds.

config CONFIG_HTTP_HAS_CGI
    bool "Enable CGI"
    default n
    help
        Enable the CGI capability.

config CONFIG_HTTP_CGI_EXTENSIONS
    string "CGI File Extension(s)"
    default ".php,.sh"
    depends on CONFIG_HTTP_HAS_CGI
    help
        Tell axhhtpd what file extension(s) are used for CGI.

        This is a comma separated list.

config CONFIG_HTTP_DIRECTORIES
    bool "Enable Directory Listing"
    default n
    help
        Enable directory listing.
    
config CONFIG_HTTP_PERM_CHECK
    bool "Permissions Check"
    default n
    help
        Enable permissions checking on the directories before reading the
        files in them.

config CONFIG_HTTP_HAS_AUTHORIZATION
    bool "Enable authorization"
    default n
    help
        Pages/directories can have passwords associated with them.

config CONFIG_HTTP_HAS_IPV6
    bool "Enable IPv6"
    default n
    depends on !CONFIG_PLATFORM_WIN32
    help
        Use IPv6 instead of IPv4.
    
        Does not work under Win32

config CONFIG_HTTP_ALL_MIME_TYPES
    bool "Use all mime types"
    default y if CONFIG_SSL_FULL_MODE
    default n if !CONFIG_SSL_FULL_MODE
    help
        Use the full list of supported mime types.

        Use this option if a "generic" webserver is used. However if it is
        using only web pages (html, jpg, gif, png, css) then select this
        option.

config CONFIG_HTTP_VERBOSE
    bool "Verbose Mode"
    default y if CONFIG_SSL_FULL_MODE
    default n if !CONFIG_SSL_FULL_MODE
    help
        Enable extra statements used when using axhttpd.

config CONFIG_HTTP_IS_DAEMON
    bool "Run as a daemon"
    default n
    depends on !CONFIG_PLATFORM_WIN32
    help 
        Run axhttpd as a background process.

        Does not work under Win32

endmenu
```
